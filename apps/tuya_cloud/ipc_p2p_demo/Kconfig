## apps/tuya_cloud/ipc_p2p_demo/Kconfig
```kconfig
menu "configure app (ipc_p2p_demo)"

    config CAMERA_DEMO
        bool
        default y
        select ENABLE_TUYA_P2P
        select ENABLE_LOCAL_STORE if PLATFORM_LINUX
        select ENABLE_IPC_RING_BUFFER

    config CAMERA_DEMO_WIDTH
        int "Capture width, pixels"
        depends on CAMERA_DEMO

    config CAMERA_DEMO_HEIGHT
        int "Capture height, pixels"
        depends on CAMERA_DEMO

    config CAMERA_DEMO_FPS
        int "Frame rate the encoder is configured for"
        depends on CAMERA_DEMO

    config CAMERA_DEMO_KBPS
        int "Encoder target bitrate, kbps"
        depends on CAMERA_DEMO

    config CAMERA_DEMO_GOP
        int "Frames between I-frames"
        depends on CAMERA_DEMO && !PLATFORM_T5

    config CAMERA_DEMO_P2P_FILE_H264
        bool "P2P preview from embedded demo_video.264 (no live camera)"
        depends on CAMERA_DEMO
        depends on !PLATFORM_LINUX
        default n
        help
          T5AI bring-up only: loop Annex-B demo file for P2P instead of GC2145/DVP.
          Disable TUYA_T5AI_BOARD_CAMERA when using this. Not used on Ubuntu
          (Ubuntu already uses demo_video.264 from the filesystem).

    config CAMERA_DEMO_SD_LIVE_RECORD
        bool "Live H264 record to local_store (optional, not used by OS wukong P2P)"
        depends on CAMERA_DEMO
        depends on ENABLE_LOCAL_STORE
        default n
        help
          Optional demo extension: while LIVE preview is on, append encoded H264
          AUs to LOCAL_STORE_ROOT/rec/YYYY-MM-DD/live_<ts>.h264 and update index.txt.
          OS wukong P2P does not do LIVE SD record; leave disabled to align OS.
          On T5AI_BOARD requires SD mounted at /sdcard (default SDIO P2/P3/...).
          Uses tkl_fs APIs like examples/peripherals/sd (not tal_fs / ENABLE_FILE_SYSTEM).

    config CAMERA_DEMO_SD_RECORD_MAX_SEC
        int "Max seconds per live recording segment (roll on next I-frame)"
        depends on CAMERA_DEMO_SD_LIVE_RECORD
        default 120
        range 30 3600
        help
          Close and index the current segment after this duration, then open a new
          one on the next I-frame.

    config CAMERA_DEMO_PB_SEED
        bool "Boot-time PB seed from a fixed H264 file (bring-up only)"
        depends on CAMERA_DEMO
        depends on ENABLE_LOCAL_STORE
        default y if PLATFORM_LINUX
        default n
        help
          Copy ./demo_video.264 (LINUX) or /sdcard/pb_seed.h264 (embedded) into
          today's index for App playback without real recording.
          Prefer CAMERA_DEMO_SD_LIVE_RECORD for product-like testing.

endmenu
```

## boards/SiWx917/BRD2605A/Kconfig
```kconfig
config CHIP_CHOICE
    string
    default "SIWG917M111MGTBA"

config BOARD_CHOICE
    string
    default "BRD2605A"

config BOARD_NAME
    string
    default "brd2605a"

config BOARD_CONFIG
    bool
    default y
    select ENABLE_BUTTON
    select ENABLE_LED
    select ENABLE_AUDIO
    select ENABLE_AUDIO_CODECS
    select MP3_DECODER_STATIC_BUF

config BOARD_SW1_PIN
    int "BOARD_SW1_PIN"
    default 49

config BOARD_SW1_NAME
    string
    default "ai_chat_button"
    ---help---
        The name SW1 is registered under, and the one an application asks for
        by name. tuya.ai/your_chat_bot hard-codes "ai_chat_button"
        (ai_chat_main.c) and aborts init when tdl_button_create cannot find
        it, so the board has to publish that name -- which is what
        SIWX917_AI_DEV_KIT already does. Not settable from a .config: this
        symbol has no prompt, so a value written there is ignored.

config BOARD_SW2_PIN
    int "BOARD_SW2_PIN"
    default 2

config BOARD_SW2_NAME
    string
    default "SW2"

config BOARD_SW3_PIN
    int "BOARD_SW3_PIN"
    default 3

config BOARD_SW3_NAME
    string
    default "SW3"

config BOARD_LEDR_PIN
    int "BOARD_LEDR_PIN"
    default 50

config BOARD_LEDR_NAME
    string
    default "LEDR"

config BOARD_LEDG_PIN
    int "BOARD_LEDG_PIN"
    default 51

config BOARD_LEDG_NAME
    string
    default "LEDG"

config BOARD_LEDB_PIN
    int "BOARD_LEDB_PIN"
    default 15

config BOARD_LEDB_NAME
    string
    default "LEDB"
```
